## conf/machine/odroid-u3.conf
```bitbake
#@TYPE: Machine
#@NAME: odroid-u3
#@DESCRIPTION: Machine configuration for odroid-u3 systems
#@MAINTAINER: Aurélien Ballier <aurelien.ballier@teosit.com>

include conf/machine/include/samsung-exynos.inc

require conf/machine/include/tune-cortexa9.inc
include conf/machine/include/odroid-default-settings.inc

#GCC config
GCCVERSION ?= "5.4.0"
SDKGCCVERSION ?= "5.4.0"

PREFERRED_VERSION_gcc ?= "${GCCVERSION}"
PREFERRED_VERSION_gcc-cross ?= "${GCCVERSION}"
PREFERRED_VERSION_gcc-cross-initial ?= "${GCCVERSION}"
PREFERRED_VERSION_gcc-cross-intermediate ?= "${GCCVERSION}"
PREFERRED_VERSION_gcc-crosssdk ?= "${SDKGCCVERSION}"
PREFERRED_VERSION_gcc-crosssdk-initial ?= "${SDKGCCVERSION}"
PREFERRED_VERSION_gcc-crosssdk-intermediate ?= "${SDKGCCVERSION}"
PREFERRED_VERSION_gcc-cross-canadian ?= "${GCCVERSION}"
PREFERRED_VERSION_gcc-runtime ?= "${GCCVERSION}"
PREFERRED_VERSION_gcc-runtime-nativesdk ?= "${SDKGCCVERSION}"

#Kernel parameters
PREFERRED_PROVIDER_virtual/kernel = "linux-stable"
PREFERRED_VERSION_linux-stable = "4.11%"
KERNEL_IMAGETYPE = "zImage"
BOOT_IMAGE = "zImage"
SERIAL_CONSOLE = "115200 ttySAC1"
KERNEL_DEVICETREE = "exynos4412-odroidu3.dtb"
BOOT_EXTRA_ARGUMENTS = "uvcvideo.quirks=0x440 uvcvideo.jpg_compression=1"

#specify u-boot parameters
PREFERRED_PROVIDER_virtual/bootloader ?= "u-boot"
PREFERRED_PROVIDER_u-boot ?= "u-boot"
PREFERRED_VERSION_u-boot ?= "v2016.03+gitAUTOINC+df61a74e68"
UBOOT_MACHINE_odroid-u3 = "odroid_config"
UBOOT_CONSOLE = "console=ttySAC1,115200n8"

EXTRA_IMAGEDEPENDS += "u-boot u-boot-config"

MACHINE_FEATURES_BACKFILL_CONSIDERED = "rtc"

IMAGE_CLASSES += "image_types_odroid"
```
